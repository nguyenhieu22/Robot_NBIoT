/*
Nguyen Van Hieu.
Hoan thanh: 6-6-2024.
Chu de: He thong dieu khien Robot giam sat chat luong khong khi ung dung NB-IoT.
email: nguyenhieuvan0703@gmail.com
*/
//Khai bao thu vien 
#include <ArduinoJson.h>
#include <PubSubClient.h>
#include <SoftwareSerial.h>
#include <WiFiClientSecure.h>
#include <Adafruit_GFX.h>
#include <Adafruit_ST7735.h>
#include <SPI.h>
#include <WiFi.h>
//Dinh nghia chan UART 
#define MYPORT_TX 26    
#define MYPORT_RX 27 
//Dinh nghia chan TFT
#define TFT_CS         18     
#define TFT_RST        2                                        
#define TFT_DC         13     
#define TFT_MOSI       4     
#define TFT_SCLK       5      
Adafruit_ST7735 tft = Adafruit_ST7735(TFT_CS, TFT_DC, TFT_MOSI, TFT_SCLK, TFT_RST);
//Dinh nghia mau sac
#define BLACK   0x0000    
#define BLUE    0x001F    
#define RED     0xF800      
#define GREEN   0x07E0
#define CYAN    0x07FF
#define MAGENTA 0xF81F  
#define YELLOW  0xFFE0
#define WHITE   0xFFFF 
//Icon Logo SPKT
const unsigned char kythuatso11 []= {
	0x00, 0x00, 0x00, 0x00, 0x00, 0x00, 0x00, 0x00, 0x00, 0x00, 0x00, 0x00, 0x00, 0x00, 0x00, 0x00, 
	0x00, 0x00, 0x00, 0x00, 0x00, 0x00, 0x10, 0x00, 0x00, 0x04, 0x00, 0x00, 0x00, 0x00, 0x00, 0x00, 
	0x00, 0x00, 0x00, 0x00, 0x00, 0x00, 0x00, 0x00, 0x00, 0x00, 0x00, 0x00, 0x00, 0x00, 0x00, 0x00, 
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	0x00, 0x00, 0x00, 0x03, 0xe0, 0x00, 0x00, 0x00, 0x00, 0x07, 0xe0, 0x00, 0x00, 0x00, 0x00, 0x00
};
// Icon MQTT
const unsigned char iconwifi[]= {
	0x00, 0x00, 0x00, 0x00, 0x00, 0x00, 0x00, 0x00, 0x00, 0x00, 0x00, 0x00, 0x00, 0x07, 0xf8, 0x0f, 
	0x80, 0x00, 0x00, 0x07, 0xfe, 0x07, 0x80, 0x00, 0x00, 0x00, 0x7f, 0x83, 0x80, 0x00, 0x00, 0x00, 
	0x0f, 0xc1, 0x80, 0x00, 0x00, 0x00, 0x03, 0xe0, 0x80, 0x00, 0x00, 0x06, 0x00, 0xf0, 0x00, 0x00, 
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	0x00, 0xc0, 0x00, 0x00, 0x00, 0x00, 0x00, 0x00, 0x00, 0x00, 0x00, 0x00, 0x00, 0x00, 0x00, 0x00
};

//Dia chi mang WiFi
const char *ssid     = "Manh Loc";
const char *password = "khongxaiduoc";
//Thong so ket noi vao HiveMQ
const char* mqtt_server = "iot30-ahwwcd.a02.usw2.aws.hivemq.cloud";//URL MQTT
const int mqtt_port = 8883;//PORT URL
const char* mqtt_username = "Center"; //User Client
const char* mqtt_password = "Hieu123@"; //Password Client
/*----------------------*********************************-------------------*/
WiFiClientSecure espClient;
PubSubClient client(espClient);
EspSoftwareSerial::UART myPort;
//unsigned long lastMsg = 0;
//#define MSG_BUFFER_SIZE (50)
//char msg[MSG_BUFFER_SIZE];
StaticJsonDocument<100> doc;
unsigned long timeUpdata=millis();//Bien cho dinh thoi.
float longitude=0, latitude =0;//Bien kinh do, vi do.
unsigned int co2=0, tvoc=0, h2s=0;
unsigned int mess=0;//Bien trang thai di chuyen STM32 gui den.

/*-------------------------------------SETUP------------------------------------*/
void setup() 
{
  Serial.begin(9600); 
  myPort.begin(9600, SWSERIAL_8N1, MYPORT_RX, MYPORT_TX, false);
  if (!myPort)
  {
    Serial.println("Loi cong noi tiep TX UART STM32");
  }     
  Serial.println("Connecting to " +String(ssid)); //Ket noi vao mang wifi
  WiFi.begin(ssid, password);                 
  while ( WiFi.status() != WL_CONNECTED ) {
    delay ( 1000 );
    Serial.print ( "." );
  }
  espClient.setInsecure();
  client.setServer(mqtt_server, mqtt_port);
  client.setCallback(callback);
  setupLCD();// Thiet lap LCD                     
}   
/*--------------------------------------------MAIN--------------------------------------------*/
void loop() {
  if(millis()-timeUpdata>1000)
  {
    
    Display_Data();//Hien thi du lieu ra LCD

    if (!client.connected()) 
    {
      reconnect();
    }
    client.loop();
    timeUpdata=millis();
  }
  ReadUART_STM32();//Ham con doc UART va tach Json.
}
/*-----------------------*chuong trinh con*-----------------------------*/
void Display_Data()
{
  char buffer[10];
  char buffer1[10],buffer2[10],buffer3[20],buffer4[20];
  //Chuyen doi
  snprintf(buffer,sizeof(buffer),"%d%s  ",co2,"ppm");
  snprintf(buffer1,sizeof(buffer1),"%d%s   ",tvoc,"ppb");
  snprintf(buffer2,sizeof(buffer2),"%d  ",h2s);
  snprintf(buffer3,sizeof(buffer3),"%0.5fE  ",longitude);
  snprintf(buffer4,sizeof(buffer4),"%0.5fN ",latitude);
  tft.setCursor(67, 30);                   
  tft.setTextColor(YELLOW,BLACK);
  tft.setTextSize(1);
  tft.print(buffer);//Hien thi du lieu CO2.

  tft.setCursor(67, 51);                
  tft.setTextColor(YELLOW,BLACK);
  tft.setTextSize(1);
  tft.print(buffer1);//Hien thi du lieu TVOC.

  tft.setCursor(67, 72);                
  tft.setTextColor(YELLOW,BLACK);
  tft.setTextSize(1);
  tft.print(buffer2);//Hien thi du lieu H2S.

  tft.setCursor(59, 88);                
  tft.setTextColor(YELLOW,BLACK);
  tft.setTextSize(1);
  tft.print(buffer4);//Hien thi du lieu vi do(N).
  
  tft.setCursor(59, 103);                
  tft.setTextColor(GREEN,BLACK);
  tft.setTextSize(1);
  tft.print(buffer3);//Hien thi du lieu kinh do(E).
}

// Doc du lieu UART tu STM32 va tach chuoi Json.
void ReadUART_STM32()
{
  if(myPort.available() )
  {
    String line = myPort.readStringUntil('\n') ;
    Serial.println(line);
    DeserializationError error = deserializeJson(doc,line);
    if(error)
    {
      Serial.print("deserializeJson() failed: ");//In ra loi du lieu Json.
      Serial.println(error.c_str());
    }
    else
    {
      mess = doc["Mess"];
      Serial.print("Mess:");
      Serial.println(mess);
    }
    doc.clear();//Xoa bo nho dem
    delay(10);
    tft.setCursor(60, 122);//Hien thi huong dieu khien
    tft.setTextColor(GREEN,BLACK);
    tft.setTextSize(2);
    switch(mess)
    {
      case 1: tft.print("  Up ");break;
      case 2: tft.print("Down ");break;
      case 3: tft.print("Left ");break;
      case 4: tft.print("Right ");break;
      case 5: tft.print("Stop ");break;
    }
  }
}
// Ham con thiet lap LCD TFT
void setupLCD()
{
  tft.initR(INITR_BLACKTAB);                          //Thiet lap LCD TFT
  tft.fillScreen(WHITE);                              //Thiet lap mau nen LCD
  tft.drawBitmap(1, 1, kythuatso11, 128, 160, BLUE);  //Hien thi LOGO SPKT
  delay(3000);
  tft.fillScreen(BLACK);                              //Thiet lap mau nen Den
  printText("DO AN TOT NGHIEP",CYAN,17,2,1);         
  printText("DIEN TU - VIEN THONG",YELLOW,4,13,1);
  printText("CO2",BLUE,5,25,2);
  printText("TVOC",YELLOW,5,46,2);
  printText("H2S",CYAN,5,67,2);
  printText("Longitude",CYAN,3,102,1);
  printText("latutide",WHITE,3,88,1);

  tft.drawRect(2,22,55,20,GREEN); 
  tft.drawRect(2,43,55,20,BLUE);
  tft.drawRect(2,64,55,20,WHITE);
  tft.drawRect(2,86,55,11,RED);
  tft.drawRect(2,100,55,11,RED);
  tft.drawRect(1,119,128,2,MAGENTA);
  tft.drawRect(42,119,128,20,MAGENTA);
  tft.drawBitmap(1,122,iconwifi,46,40,WHITE);  //Hien thi icon nhiet do va do am
}
//Ham con viet ky tu len LCD
void printText(char *text, uint16_t color, int x, int y, int textSize)
{
  tft.setCursor(x, y);
  tft.setTextColor(color,BLACK);
  tft.setTextSize(textSize);
  tft.print(text);
}
//Ham con ket noi lai voi MQTT
void reconnect() {
  while (!client.connected()) 
  {
    Serial.print("Attempting MQTT connection...");
    String clientID =  "ESPClient-";
    clientID += String(random(0xffff),HEX);
    if (client.connect(clientID.c_str(), mqtt_username, mqtt_password)) 
    {
      printText("DA KET NOI ",YELLOW,58,150,1);
      Serial.println("MQTT connected");
      client.subscribe("iot/66");   //Dang ky Toppic("iot/66");
    } 
    else 
    {
      Serial.print("failed, rc=");
      Serial.print(client.state());
      Serial.println(" try again in 5 seconds");
      printText("MAT KET NOI",YELLOW,58,150,1);
      delay(5000);
    }
  }
}
//Call back Method for Receiving MQTT massage
void callback(char* topic, byte* payload, unsigned int length) 
{
  String incommingMessage = "";
  for(int i=0; i<length;i++) incommingMessage += (char)payload[i];
  Serial.println("Massage arived ["+String(topic)+"]"+incommingMessage);
  Serial.println(incommingMessage);
  DeserializationError error = deserializeJson(doc,incommingMessage);
  co2=doc["C"];
  tvoc= doc["T"];
  longitude=doc["E"];
  latitude =doc["N"];
  h2s = doc["H"];
  //In du lieu ra kiem tra
  Serial.print("CO2:");
  Serial.println(co2);
  Serial.print("TVOC:");
  Serial.println(tvoc);
  Serial.print("H2S:");
  Serial.println(h2s);
  Serial.print("E:");
  Serial.println(longitude);
  Serial.print(":");
  Serial.println(latitude);
  doc.clear();
}
//Method for Publishing MQTT Messages (ung dung nay khong dung Publish)
void publishMessage(const char* topic, String payload, boolean retained)
{
  if(client.publish(topic,payload.c_str(),true))
    Serial.println("Message published ["+String(topic)+"]: "+payload);
}

